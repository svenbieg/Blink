//==============
// linker.ld.in
//==============

#include "Settings.h"

SECTIONS
{
. = 0x80000;

.text :
	{
	KEEP(*(.text.start))
	*(.text .text.*)
	}

.eh_frame :
	{
	KEEP(*(.eh_frame*))
	}

.data :
	{
	KEEP(*(.gcc_except_table .gcc_except_table.*))
	KEEP(*(.got*))
	__init_array_start = .;
	KEEP(*(.init_array*))
	__init_array_end = .;
	*(.rodata .rodata.*)
	*(.data .data.*)
	}

.bss (NOLOAD) :
	{
	. = ALIGN(8);
	__bss_start = .;
	*(.bss*)
	*(COMMON)
	. = ALIGN(8);
	__bss_end = .;
	}

.stack (NOLOAD) :
	{
	. = ALIGN(STACK_SIZE);
	__stack_start = .;
	. += CPU_COUNT * STACK_SIZE;
	__stack_end = .;
	}

__end = .;
__heap_start = .;

/DISCARD/ :
	{
	*(.comment)
	*(.dtors)
	#ifndef _DEBUG
	*(.debug_*)
	#endif
	}

}
